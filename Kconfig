## Kconfig
```kconfig
mainmenu "AlexanderARodin meta-configurator for custom Linux Kernel"

source "submenu/Kconfig.000-overview"

source "submenu/Kconfig.100-minLoadable"
source "submenu/Kconfig.200-minUseful"

source "submenu/Kconfig.250-StdRec"

source "submenu/Kconfig.300-EFI"
source "submenu/Kconfig.400-BlockAndFS"

comment "| OPTIONs |"
#source "submenu/Kconfig.500-VGUEST-common"
source "submenu/Kconfig.501-VGUEST-microvm"

comment "| PHYSICAL |"
source "submenu/Kconfig.600-SamsungAtom"


comment "| COMPILER etc |"
config WERROR
	bool "Compile the kernel with warnings as errors"
	default y
config KALLSYMS
	bool "Size but symbolic crash info"
	default y
config SYMBOLIC_ERRNAME
	bool "Symbolic error names in printf"
	default y
config JUMP_LABEL
	bool "Optimize very [un]likely branches (why not?)"
	default y
config SECCOMP
	bool "to safely exec untrusted bytcode"
	default y
config STACKPROTECTOR
	bool "STACKPROTECTOR"
	default y
config LOCALVERSION_AUTO
	bool "LOCALVERSION_AUTO"
	default n

comment "| DEBUG etc |"
config EARLY_PRINTK
	bool "early PRINTK (prob Y)"
	default y
config PANIC_ON_OOPS
	bool "test with more attention for data corruption"
	default n
config PANIC_TIMEOUT;
	int "timeout to reload after crush"
	default 15
```

## list/Kconfig.400-BlockAndFS
```kconfig
menuconfig BLOCK
	bool "Enable the block layer and FS"
	default y

if BLOCK
	config BLOCK_LEGACY_AUTOLOAD
		bool "BLOCK_LEGACY_AUTOLOAD (OLD)"
		default n
	config MQ_IOSCHED_DEADLINE
		tristate "MQ_IOSCHED_DEADLINE (if cgroups NOT)"
		default y
	config MQ_IOSCHED_KYBER
		tristate "Kyber I/O scheduler (probably NO)"
		default n
	config IOSCHED_BFQ
		tristate "BFQ I/O scheduler (probably YES)"
		default y
	config PARTITION_ADVANCED
		bool "does nothing but opens options menu"
		default y

	config BLK_DEV_LOOP
		tristate "Loopback device support"
		default m
		config BLK_DEV_LOOP_MIN_COUNT
			int "Number of pre-created at init time loop devs"
			depends on BLK_DEV_LOOP
			default 4
	comment "[ File systems ]"
		config VALIDATE_FS_PARSER
			bool "VALIDATE_FS_PARSER (why not?)"
			default y
		config EXT4_FS
			tristate "Ext4"
			default m
			config EXT4_FS_SECURITY
				bool "SELinux-like security labels (recommended)"
				default y
				depends on EXT4_FS
		config FUSE_FS
			tristate "FUSE_FS"
			default m
			config VIRTIO_FS
				tristate "VIRTIO_FS: needs for sharing guest-host"
				default n
		config OVERLAY_FS
			tristate "OVERLAY_FS"
			default m
		config MISC_FILESYSTEMS
			bool "MISC_FILESYSTEMS"
			default y
		config SQUASHFS
			tristate "SQUASHFS"
			depends on MISC_FILESYSTEMS
			default m

	comment "[ PSEUDO file systems ]"
		config TMPFS
			bool "tmpfs"
			default y
			config TMPFS_XATTR
				bool "XATTR (recommended)"
				default y
				depends on TMPFS
		config EFIVAR_FS
			tristate "EFI Variable FS"

	comment "[ FS related functionality ]"
		config INOTIFY_USER
			bool "File&Dirs change notificator"
			default y
		config FANOTIFY
			bool "Wide access notification (?)"
			default y
		config DNOTIFY
			bool "Compatibility with some apps (old on-Dir-change)"
			default y

	comment "[ NLS ]"
		config NLS_DEFAULT
			string "NLS_DEFAULT: recommended utf8 but default iso8859-1"
			default "utf8"

endif	#BLOCK
```

## list/Kconfig.500-VGUEST
```kconfig
menu "VM guesting"

comment "[ guesting itself ]"
config HYPERVISOR_GUEST
	bool "Running as Guest under Hypervisor"
	default n
	config PARAVIRT
		bool "PARAVIRT: recommended (?)"
		default y
		depends on HYPERVISOR_GUEST

comment "[ guesting drivers ]"
config VIRTIO_MENU
	bool "VIRTIO_MENU: just opens menu"
	default y
config VIRTIO_MMIO
	tristate "memory mapped VIRTIO"
	default n
config VIRTIO_INPUT
	tristate "VIRTIO keyboards, mice & tablets"
	default n

endmenu
```

## submenu/Kconfig.100-minLoadable
```kconfig
menu "COMMON: critical"

comment "| inird |"
	config BLK_DEV_INITRD
		bool "support INITRD"
		default y
		config RD_GZIP
			bool "gzip"
			default y
			depends on BLK_DEV_INITRD
		config RD_BZIP2
			bool "bzip2"
			default n
			depends on BLK_DEV_INITRD
		config RD_LZMA
			bool "LZMA"
			default n
			depends on BLK_DEV_INITRD
		config RD_XZ
			bool "XZ"
			default y
			depends on BLK_DEV_INITRD
		config RD_LZ0
			bool "LZ0"
			default y
			depends on BLK_DEV_INITRD
		config RD_LZ4
			bool "LZ4"
			default n
			depends on BLK_DEV_INITRD
		config RD_ZSTD
			bool "ZSTD"
			default n
			depends on BLK_DEV_INITRD

comment "| kernel should speak |"
	config PRINTK
		bool "PRINTK"
		default y
		config PRINTK_TIME
			bool "PRINTK_TIME"
			default y
			depends on PRINTK
	
comment "| where to speak |"
	config TTY
		bool "TTY"
		default y
			config UNIX98_PTYS
				bool "UNIX98_PTYS (required for '/dev/pts/' and '/dev/ptmx')"
				default y
				depends on TTY
			config LEGACY_PTYS
				bool "LEGACY_PTYS"
				depends on TTY

comment "| keyboard |"
	config KEYBOARD_ATKBD
		bool "AT keyboard (doesn't simple work as module)"
		default y

comment "| launcher |"
	config BINFMT_ELF
		bool "Kernel support for ELF binaries"
		default y
	config BINFMT_SCRIPT
		bool "Kernel support for scripts starting with #!"
		default y

endmenu
```

## submenu/Kconfig.200-minUseful
```kconfig
menu "COMMON: usable"

config PROC_FS
	bool "/proc file system support"
	default y
config SYSFS
	bool "sysfs file system support"
	default y

config DEVTMPFS
	bool "Maintain a devtmpfs filesystem to mount at /dev"
	default y
config DEVTMPFS_MOUNT
	bool "Automount devtmpfs at /dev, after the kernel mounted the rootfs"
	default y
	depends on DEVTMPFS
config DEVTMPFS_SAFE
	bool "auto nosquid etc for mountin devtmpfs at /dev (may break non-KVS)"
	default y
	depends on DEVTMPFS

config SHMEM
	bool "backend for SWAP and TmpFS (maybe N for microvm)"
	default y

comment "| others |"
	config MULTIUSER
		bool "Enable uid and gid supports not 0 (root) value"
		default y
	config POSIX_TIMERS
		bool "POSIX_TIMERS (for ping etc)"
		default y
	config FUTEX
		bool "FUTEX (for lshw)"
		default y

config IA32_EMULATION
	bool "Y for for 32bit bin or Wine"
	default n
	depends on 64BIT

config SERIO_SERPORT
	tristate "Serial port line discipline (?)"
	default n
config HID
	tristate "HID bus support"
	default n



endmenu
```

## submenu/Kconfig.250-StdRec
```kconfig
menu "Standard and Recommended"

comment "| General |"
	config SMP
		bool "Symmetric multi-processing support"
		default y
	config RELOCATABLE
		bool "Recloable kernel"
		default y
	config MODIFY_LDT_SYSCLL
		bool "Enable LDT (for 16-app or/and some Wine)"
		default n
	config SYSVIPC
		bool "System V IPC"
		default y
	config WATCH_QUEUE
		bool "General notification queue"
		default y
	config EPOLL
		bool "EPOLL (?)"
		default y
	config BUG
		bool "BUG() support"
		default y

comment "| Drivers |"
	config PCI
		bool "PCI"
		default y
	config USB_SUPPORT
		bool "USB support"
		default y
	config LEGACY_TIOCSTI
		tristate "LEGACY_TIOCSTI"
		default n
	config SERIAL_8250
		tristate "SERIAL_8250 (for ttyS0)"
		default y
	config SERIAL_8250_CONSOLE
		bool "SERIAL_8250_CONSOLE (for ttyS0)"
		default y
	config SERIAL_8250_PCI
		tristate "SERIAL_8250_PCI (?)"
		default n
	config SERIAL_8250_EXAR
		tristate "SERIAL_8250_EXAR (seems N(?))"
		default n

comment "| Timers |"
		config NO_HZ_IDLE
			bool "Idle dynticks (tickless idle)"
			default y
		config NO_HZ
			bool "Old Idle dynticks config (for compat)"
			default y
		config HIGH_RES_TIMERS
			bool "High Resolution Time Support"
			default y
	comment "| BPF |"
		config BPF_SYSCALL
			bool "Enable bpf() system call"
			default y
		config BPF_JIT
			bool "BPF JIT"
			default y
	comment "| Preemption model |"
		config PREEMPT
			bool "Low-Latency Desktop or Embedded"
			default y


endmenu
```

## submenu/Kconfig.300-EFI
```kconfig
menuconfig EFI_RELATED
	bool "EFI related"
	default n

if EFI_RELATED

	config ACPI
		bool "ACPI"
		default y
		config EFI
			bool "EFI runtime service support"
			default y
			depends on ACPI
			config EFI_STUB
				bool "boot directly from EFI firmware without bootloader"
				default y
				depends on EFI
			config EFIVAR_FS
				tristate "EFI Variable FS"
				default m
				depends on EFI
			config FB
				tristate "Framebuffer support"
				default y
			config FB_EFI
				bool "EFI-based Framebuffer support"
				default y
				depends on EFI
				depends on FB
	config EFI_PARTITION
		bool "EFI GUID Partition support"
		default y

endif	#EFI_RELATED
```

## submenu/Kconfig.500-VGUEST-common
```kconfig
menuconfig HYPERVISOR_GUEST
	bool "Running as Guest under Hypervisor"
	default n

if HYPERVISOR_GUEST

	comment "| guesting itself |"
	config PARAVIRT
		bool "PARAVIRT: recommended (?)"
		default y
		depends on HYPERVISOR_GUEST

	comment "| guesting drivers |"
	config VIRTIO_MENU
		bool "VIRTIO_MENU: just opens menu"
		default y
	config VIRTIO_INPUT
		tristate "VIRTIO keyboards, mice & tablets"
		default y
	config VIRTIO_MMIO
		tristate "VIRTIO_MMIO"
		default y
	config VIRTIO_IOMMU
		tristate "VIRTIO_IOMMU"
		default y
	config VIRTIO_BLK
		tristate "attach disks for microvm too"
		default y
	config VIRTIO_FS
		tristate "VIRTIO_FS"
		default y

	comment "| 9p drivers |"
	config NET
		bool "NET (for 9p)"
		default y
	config NET_9P
		tristate "NET_9P (share dirs)"
		default m
	config NET_9P_FD
		tristate "NET_9P_FD"
		default n
		depends on NET_9P
	config NET_9P_VIRTIO
		tristate "NET_9P_VIRTIO"
		default m
		depends on NET_9P
	config NET_9P_DEBUG
		bool "NET_9P_DEBUG (for debuggin stage)"
		default n
		depends on NET_9P
	config 9P_FS
		tristate "9P_FS (share dirs)"
		default m
		depends on NET_9P
	config 9P_FS_POSIX_ACL
		bool "9P_FS_POSIX_ACL (?)"
		default n
	config PCI
		tristate "PCI: seems to be needed (check?)"
		default y
	config VIRTIO_PCI
		tristate "VIRTIO_PCI: seems to be needed (check?)"
		default y

endif
```

## submenu/Kconfig.501-VGUEST-microvm
```kconfig
menuconfig MICROVM_HYPERVISOR_GUEST
	bool "microvm VGUEST"
	default n
	select HYPERVISOR_GUEST
	select VIRTIO_MMIO
	select VIRTIO_MENU

if MICROVM_HYPERVISOR_GUEST

#	comment "| guesting itself |"
#	config PARAVIRT
#		bool "PARAVIRT: recommended (?)"
#		default y
#		depends on HYPERVISOR_GUEST

	comment "| CRUCIAL (Y) |"
		config VIRTIO_MENU
			bool "VIRTIO_MENU: just opens menu"
		config VIRTIO_MMIO
			tristate "VIRTIO_MMIO"
		config VIRTIO_MMIO_CMDLINE_DEVICES
			bool "VIRTIO_MMIO_CMDLINE_DEVICES"
			default y
	
	comment "| TERMINAL |"
		config SERIAL_8250
			tristate "SERIAL_8250 (for ttyS0)"
			default y
		config SERIAL_8250_CONSOLE
			bool "SERIAL_8250_CONSOLE (for ttyS0)"
			default y
		config VIRTIO_CONSOLE
			tristate "VIRTIO_CONSOLE (/dev/hvcX)"
			default n

	comment "| BLOCK Dev |"
	config VIRTIO_BLK
		tristate "VIRTIO_BLK"
		default n

	comment "| IMPORANT |"
	config VIRTIO_IOMMU
		tristate "VIRTIO_IOMMU"
		default n
	config VIRTIO_FS
		tristate "VIRTIO_FS"
		default y

	comment "| NETWORK |"

	comment "| UNUSED (N) |"
		config VIRTIO_PCI
			tristate "VIRTIO_PCI"
			default n
		config VIRTIO_INPUT
			tristate "VIRTIO keyboards, mice & tablets"
			default n
		config INPUT_KEYBOARD
			tristate "INPUT_KEYBOARD"
			default n
		config INPUT_MOUSE
			tristate "INPUT_MOUSE"
			default n
		config SERIAL_8250_PCI
			tristate "SERIAL_8250_PCI"
			default n
		config USB_SUPPORT
			bool "USB"
			default n
		config PCI
			bool "PCI"
			default n
		config SERIO_SERPORT
			tristate "Serial port line discipline"
			default n
		config HID
			tristate "HID bus support"
			default n

endif
```

## submenu/Kconfig.600-SamsungAtom
```kconfig
menuconfig SAMSUNG_ATOM
	bool "SAMSUNG Atom"
	default n

if SAMSUNG_ATOM

	comment "| General |"
	config ACPI
		bool "ACPI (poweroff etc)"
		default y
	config RTC_CLASS
		bool "RTC_CLASS"
		default y
		config RTC_DRV_CMOS
			tristate "RTC_DRV_CMOS"
			default y
			depends on RTC_CLASS
	config PCI
		bool "PCI"
		default y
		config PCIEPORTBUS
			bool "PCIEPORTBUS"
			default y
			depends on PCI
	config SCSI
		tristate "SCSI"
		default m
	config ATA
		tristate "ATA"
		default m
		config SATA_AHCI
			tristate "SATA_AHCI"
			default m
			depends on ATA

	comment "| USB |"
	config USB_SUPPORT
		bool "USB_SUPPORT"
		default y
		config USB_PCI
			bool "USB_PCI"
			default y
			depends on USB_SUPPORT
			depends on PCI
		config USB
			tristate "USB"
			default m
			depends on USB_SUPPORT
			config USB_HUB_USB251XB
				bool "USB_HUB_USB251XB: ?? hub ??"
				default m
				depends on USB
			config USB_ANNOUNCE_NEW_DEVICES
				bool "USB_ANNOUNCE_NEW_DEVICES"
				default y

			config USB_UHCI_HCD
				tristate "USB_UHCI_HCD"
				default m
				depends on USB
				depends on USB_PCI
			config USB_EHCI_HCD
				tristate "USB_EHCI_HCD"
				default m
				depends on USB

			config USB_STORAGE
				tristate "USB_STORAGE"
				default m
				depends on USB
				depends on SCSI

	comment "| Networking |"
	config NET
		bool "NET"
		default y
		config BT
			tristate "Bluetooth"
			default m
			depends on NET
			config BT_HCIBTUSB
				tristate "BT_HCIBTUSB"
				default m
				depends on BT
		config CFG80211
			tristate "CFG80211"
			default m
			depends on NET
			config MAC80211
				tristate "MAC80211"
				default m
				depends on CFG80211

	config CORDIC
		tristate "CORDIC: fixed point alg"
		default m
	config FW_LOADER
		tristate "FW_LOADER: firmware loader"
		default m

		config NETDEVICES
			bool "NETDEVICES"
			default y
			depends on NET
			config WLAN
				bool "WLAN"
				default y
				depends on NETDEVICES
				config BCMA
					bool "BCMA"
					default y
					depends on WLAN
				config BRCMSMAC
					tristate "BRCMSMAC: WiFi"
					default m
					depends on WLAN

			config SKY2
				tristate "SKY2: ethernet"
				default m
				depends on NETDEVICES

	comment "| Graphics |"
		config FB
			tristate "Framebuffer support (otherwise i915 shows black screen)"
			default m
		config DRM
			tristate "DRM"
			default m
			config DRM_I915
				tristate "DRM_I915"
				default m
				depends on DRM

	comment "| Sound |"
		config SOUND
			tristate "SOUND"
			default m
			config SND
				tristate "SND"
				default m
				depends on SOUND
				config SND_HDA_INTEL
					tristate "SND_HDA_INTEL"
					default m
					depends on SND

	comment "| others |"
		config I2C_I801
			tristate "I2C_I801: SMBus (serial)"
			default m

endif #SAMSUNG_ATOM
```
