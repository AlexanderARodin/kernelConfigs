## list/Kconfig.000-overview
```kconfig
config DEFAULT_HOSTNAME
	string "Default hostname"
	default "raaNux"

config 64BIT
	bool "64-bit kernel"
	default y

menuconfig MODULES
	bool "Enable loadable module support"
	modules
	default y

if MODULES
	config MODULE_UNLOAD
		bool "MODULE_UNLOAD"
		default y
		config MODULE_FORCE_UNLOAD
			bool "MODULE_FORCE_UNLOAD"
			depends on MODULE_UNLOAD
			default y
endif	#MODULES

#config EXPERT
#	def_bool y
```

## list/Kconfig.100-minLoadable
```kconfig
menu "COMMON: critical"

comment "[ inird ]"
	config BLK_DEV_INITRD
		bool "support INITRD"
		default y
	if BLK_DEV_INITRD
		config RD_GZIP
			bool "gzip"
			default y
		config RD_BZIP2
			bool "bzip2"
			default n
		config RD_LZMA
			bool "LZMA"
			default n
		config RD_XZ
			bool "XZ"
			default n
		config RD_LZ0
			bool "LZ0"
			default y
		config RD_LZ4
			bool "LZ4"
			default n
		config RD_ZSTD
			bool "ZSTD"
			default n
	endif

comment "[ kernel should speak ]"
	config PRINTK
		bool "PRINTK"
		default y
	config PRINTK_TIME
		bool "PRINTK_TIME"
		default y
		depends on PRINTK
	
	config TTY
		bool "TTY"
		default y
	if TTY
		config UNIX98_PTYS
			bool "UNIX98_PTYS"
		config LEGACY_PTYS
			bool "LEGACY_PTYS"
	endif

comment "[ launcher ]"
	config BINFMT_ELF
		bool "Kernel support for ELF binaries"
		default y
	config BINFMT_SCRIPT
		bool "Kernel support for scripts starting with #!"
		default y

endmenu
```

## list/Kconfig.200-minUseful
```kconfig
menu "COMMON: usable"

config PROC_FS
	bool "/proc file system support"
	default y
config SYSFS
	bool "sysfs file system support"
	default y

config DEVTMPFS
	bool "Maintain a devtmpfs filesystem to mount at /dev"
	default y
config DEVTMPFS_MOUNT
	bool "Automount devtmpfs at /dev, after the kernel mounted the rootfs"
	default y
	depends on DEVTMPFS

comment "[ others ]"
	config BUG
		bool "BUG() support"
		default y

config IA32_EMULATION
	bool "needs for 32bit bin or Wine"
#	default y
	depends on 64BIT

	config SERIO_SERPORT
		def_tristate m
		prompt "Serial port line discipline"
	config HID
		def_tristate m
		prompt "HID bus support"


endmenu
```

## list/Kconfig.250-StdRec
```kconfig
menu "Standard and Recommended"

comment "[ General ]"
	config BUG
		bool "BUG() support"
		default y


endmenu
```

## list/Kconfig.500-for_qemu
```kconfig
config FOR_QEMU_GROUP
	bool "for QEMU"
	
if FOR_QEMU_GROUP
	menu "minimal"
		source "./list/qemu/Kconfig.510-minQEMU"
	endmenu
	menu "recommended"
		source "./list/qemu/Kconfig.520-midQEMU"
	endmenu
	menu "extended"
		source "./list/qemu/Kconfig.530-extQEMU"
	endmenu
endif
```

## list/qemu/Kconfig.510-minQEMU
```kconfig
menu "CPU"
	menu "--- Intel 06/9e (family: 0x6, model: 0x9e, stepping: 0xd)"
	endmenu
	config SMP
		bool "SMP"
		default y
	config X86_MPPARSE
		bool "Enable MPS table"
	config NR_CPUS
		int "max CPUs"
		default 4
		depends on SMP
		
	menu "---- GUEST under HYPERVISOR"
	endmenu
	config HYPERVISOR_GUEST
		bool "HYPERVISOR_GUEST"
		default y
	if HYPERVISOR_GUEST
		config PARAVIRT
			bool "PARAVIRT"
			default y
		config PARAVIRT_SPINLOCKS
			bool "PARAVIRT_SPINLOCKS"
			default y
		config PARAVIRT_TIME_ACCOUNTING
			bool "PARAVIRT_TIME_ACCOUNTING"
			default y
	endif

	menu "---- others"
	endmenu
	config LEGACY_VSYSCALL_NONE
		bool "legacy_vsyscall_none"
		default y
endmenu


menu "BOARD & BUS"
	config RTC_CLASS
		bool "rtc_class"
		default y
	config DMI
		bool "DMI"
		default y
	config ACPI
		bool "ACPI"
		default y
	config ACPI_BUTTON
		tristate "ACPI_BUTTON"
		default m
	config ACPI_AC
		bool "acpi_ac"
	config ACPI_BATTERY
		bool "acpi_battery"
	config ACPI_FAN
		bool "acpi_fan"
	config ACPI_THERMAL
		bool "acpi_thermal"

	menu "---- BUS"
	endmenu
	config PCI
		bool "pci"
		default y
	config VIRTION_MENU
		bool "VIRTION_MENU"
		default y
	config VIRTIO_PCI
		bool "VIRTIO_pci"
		default y

endmenu

menu "network"
	config IPV6
		tristate "IPv6"
		default m
	config NET
		bool "NET"
		default y
	config INET
		bool "INET"
		default y
	config NETDEVICES
		bool "NETDEVICES"
		default y
	config NETFAILOVER
		bool "NETFAILOVER"
		default y
	config VIRTIO_NET
		tristate "virtio-net"
		default m
	config WIRELESS
		bool "WIRELESS"
		default n
	config WLAN
		bool "WLAN"
		default n
	config USB_NET_DRIVER
		bool "USB_NET_DRIVER"
		default n
	config ETHERNET
		bool "ETHERNET"
		default n
	menu "---- 9p support"
	endmenu
	config NET_9P
		bool "net 9p"
		default y
	if NET_9P
		config NET_9P_VIRTIO
			bool "NET_9P_VIRTIO"
			default y
		config 9P_FS
			tristate "9P_FS"
			default m
		config 9P_FS_POSIX_ACL
			bool "9P_FS_POSIX_ACL"
			default y
	endif
	menu "---- others"
	endmenu
		config POSIX_TIMERS
			bool "POSIX_TIMERS"
			default y
endmenu

menu "Input devices"
	config INPUT_MOUSDEV
		tristate "INPUT_MOUSDEV"
		default m
	config MOUSE_PS2
		tristate "MOUSE_PS2"
		default m
	config USERIO
		tristate "USERIO"
		default m
	config INPUT_TABLET
		bool "INPUT_TABLET"
		default y
endmenu
```

## list/qemu/Kconfig.520-midQEMU
```kconfig
config PCI
	bool "pci"
	default y
if PCI
	config LPC_ICH
		tristate "Intel ICH LPC"
		default y
	config I2C_I801
		tristate "Intel 82801 (ICH/PCH)"
		default y
endif #PCI

config BLOCK
	bool "Enable the BLOCK layer"
	default y

if BLOCK
	menu "disks"
		config ATA
			tristate "ATA"
			default y
			depends on BLOCK
		if ATA
			config SATA_AHCI
				tristate "SATA_AHCI"
				default y
				select SCSI
		endif #ATA
		
		config SCSI
			tristate "SCSI"
			default y
		if SCSI
			config BLK_DEV_SD
				tristate "BLK_DEV_SD"
				default y
			config BLK_DEV_SR
				tristate "BLK_DEV_SR"
				default y
			config CHR_DEV_SG
				bool "CHR_DEV_SG"
				default y
			config SCSI_VIRTIO
				tristate "SCSI_VIRTIO"
				default m
				#depends on VIRTIO
			config VIRTIO_BLK
				tristate "VIRTIO_BLK"
				default m
				#depends on VIRTIO
		endif #SCSI
	endmenu # discs
	
	menu "block FS"

		config EXT2_FS
			tristate "Ext2 support"
			default y
		config EXT4_FS
			tristate "Ext4 support"
			default m
			config EXT4_FS_POSIX_ACL
				bool "Ext4 POSIX Access Control Lists"
				default y
				depends on EXT4_FS

		comment "[ CD-ROM/DVD ]"
		config ISO9660_FS
			tristate "ISO 9660 CDROM file system support"
			default m
		if ISO9660_FS
			config JOLIET
				bool "Microsoft Joliet CDROM extensions"
				default y
				select NLS
			config ZISOFS
				bool "Transparent decompression extension"
				default y
		endif
		config UDF_FS
			tristate "UDF file system support"
			default m
			select NLS

		comment "[ Windows FATs ]"
		config VFAT_FS
			tristate "VFAT (Windows-95) fs support"
			default m
		if VFAT_FS
			config FAT_DEFAULT_IOCHARSET
				string "Default iocharset for FAT"
				default "ascii"
			config FAT_DEFAULT_UTF8
			 bool "Enable FAT UTF-8 option by default"
			 default y
		endif
		config EXFAT_FS
			tristate "exFAT filesystem support"
			default m
			select NLS
	endmenu
endif #BLOCK


menuconfig NETWORK_FILESYSTEMS
	bool "Network File Systems"
	default y
	depends on NET
if NETWORK_FILESYSTEMS
	config CIFS
		tristate "SMB3 and CIFS support (advanced network filesystem)"
		default m
	if CIFS
		config CIFS_XATTR
			bool "CIFS extended attributes"
			default y
		config CIFS_POSIX
			bool "CIFS POSIX Extensions"
			default y
	endif #CIFS
	config 9P_FS
		tristate "Plan 9 Resource Sharing Support (9P2000)"
		default m
		depends on INET && NET_9P
		config 9P_FS_POSIX_ACL
			bool "9P POSIX Access Control Lists"
			default y
			depends on 9P_FS
endif #NETWORK_FILESYSTEMS

menu "FS language support"
	config NLS
		bool "Native language support"
		default y
	if NLS
		config NLS_DEFAULT
			string "Default NLS Option"
			default "untf8"
		config NLS_ASCII
			tristate "ASCII (United States)"
			default m
		config NLS_UTF8
			tristate "NLS UTF-8"
			default m
	endif #NLS
	config UNICODE
		bool "UTF-8 normalization and casefolding support"
		default y
endmenu
	
menu "hardware RANDOM"
	config HW_RANDOM
		tristate "HW_RANDOM"
		default y
	if HW_RANDOM
		config HW_RANDOM_VIRTIO
			tristate "HW_RANDOM_VIRTIO"
			default y
		config HW_RANDOM_INTEL
			tristate "HW_RANDOM_INTEL"
			default n
		config HW_RANDOM_AMD
			tristate "HW_RANDOM_AMD"
			default n
		config HW_RANDOM_VIA
			tristate "HW_RANDOM_VIA"
			default n
	endif
endmenu

menu "Graphics"
	config VGA_ARB
		bool "VGA_ARB"
		default n
	config DRM
		tristate "DRM"
		default y
	config DRM_BOCHS
		tristate "DRM_BOCHS"
		default y
	config DUMMY_CONSOLE_COLUMNS
		int "DUMMY_CONSOLE_COLUMNS"
		default 128
	config DUMMY_CONSOLE_ROWS
		int "DUMMY_CONSOLE_ROWS"
		default 48
endmenu
```

## list/qemu/Kconfig.530-extQEMU
```kconfig
config MULTIUSER
	bool "Multiple users, groups and capabilities support"
	default y

config VIRTIO_CONSOLE
	tristate "Virtio console"
	default m
config VIRTIO_INPUT
	tristate "Virtio input driver"
	default m
config VSOCKETS
	tristate "Virtual Socket protocol"
	default m

config INET_DIAG
	tristate "INET: socket monitoring interface"
	default m
if INET_DIAG
	config INET_UDP_DIAG
		tristate "UDP: socket monitoring interface"
		default m
	config INET_RAW_DIAG
		tristate "RAW: socket monitoring interface"
		default m
endif #INET_DIAG



config X86_MSR
	tristate "/dev/cpu/*/msr - Model-specific register support"
	default m
config HALTPOLL_CPUIDLE
	tristate "Halt poll cpuidle driver"
	default m


config CRYPTO_DEV_VIRTIO
	tristate "VirtIO crypto driver"
	default m
```
